## magicLight/components/ws2812b/Kconfig
```kconfig
menu "ws2812"
    config LIGHT_NUM
        int "灯珠数"
        default 5
        help
            设置要驱动的最大灯珠数量
endmenu
```

## magicLight/main/Kconfig.projbuild
```kconfig
menu "MQTT Setting"
    config BROKER_URL
        string "Broker URL"
        default "mqtt://192.168.3.140:5812"
        help
            URL of the broker to connect to
    
    config USERNAME
        string "Username"
        default "admin"
        help
            user name
            
    config PASSWORD
        string "Password"
        default "public"
        help
            password

    config WIFI_SSID
        string "WIFI SSID"
        default "ssid"
        help
            WIFI SSID

    config WIFI_PASSWORD
        string "WIFI PASSWORD"
        default "password"
        help
            WIFI PASSWORD
endmenu
```
